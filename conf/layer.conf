## conf/layer.conf
```bitbake
# We have a conf and classes directory, add to BBPATH
BBPATH .= ":${LAYERDIR}"

# We have recipes-* directories, add to BBFILES
BBFILES += "${LAYERDIR}/recipes-*/*/*.bb ${LAYERDIR}/recipes-*/*/*.bbappend"

BBFILE_COLLECTIONS += "oss-demo"
BBFILE_PATTERN_oss-demo = "^${LAYERDIR}/"
BBFILE_PRIORITY_oss-demo = "1"

# This should only be incremented on significant changes that will
# cause compatibility issues with other layers
LAYERVERSION_oss-demo = "1"

LAYERDEPENDS_oss-demo = "core"

LAYERSERIES_COMPAT_oss-demo = "styhead"
```
